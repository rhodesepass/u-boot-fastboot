## configs/suniv_f1c200s_fastburn_defconfig
```kconfig
# --- 基础硬件配置 ---
CONFIG_ARM=y
CONFIG_ARCH_SUNXI=y
CONFIG_MACH_SUNIV=y
CONFIG_DRAM_CLK=204
CONFIG_DRAM_ZQ=0
CONFIG_SYS_CLK_FREQ=604000000
# 建议使用 0x81000000 避开较低的内存区域，给内核和缓冲区留出空间
CONFIG_TEXT_BASE=0x81000000
CONFIG_SYS_LOAD_ADDR=0x80500000
CONFIG_STACK_SIZE=0x500000

# --- 设备树配置 ---
CONFIG_DEFAULT_DEVICE_TREE="allwinner/suniv-f1c100s-epass"

# --- 存储与 MTD 支持 (整合自配置 2，增加兼容性) ---
CONFIG_SPL=y
CONFIG_SPL_SPI_SUNXI=y
CONFIG_SPL_SPI_NAND_SUNXI=y
CONFIG_MTD=y
CONFIG_DM_MTD=y
CONFIG_MTD_SPI_NAND=y
CONFIG_SPI=y
CONFIG_DM_SPI=y
CONFIG_SPI_SUNXI=y
CONFIG_SPI_FLASH_MTD=y
CONFIG_MTD_PARTITIONS=y
CONFIG_CMD_MTD=y
CONFIG_CMD_MTDPARTS=y
CONFIG_MTDPARTS_DEFAULT="spi-nand0:-(full_chip)"
CONFIG_MTDIDS_DEFAULT="spi-nand0=spi-nand0"
CONFIG_MTDPARTS_DEFAULT="mtdparts=spi-nand0:-(full_chip)"
CONFIG_FASTBOOT_MTD_NAME="spi-nand0"
# 增加更多型号 Flash 支持
CONFIG_SPI_FLASH_WINBOND=y
CONFIG_SPI_FLASH_XTX=y
CONFIG_MTD_CMDLINE_PARTS=y
CONFIG_SPI_FLASH_GIGADEVICE=y

# --- USB Gadget & Fastboot 核心配置 (重点优化) ---
CONFIG_USB=y
CONFIG_DM_USB=y
CONFIG_USB_MUSB_SUNXI=y
CONFIG_USB_MUSB_GADGET=y
CONFIG_USB_GADGET=y
# CONFIG_USB_GADGET_DUALSPEED=y
CONFIG_USB_GADGET_DOWNLOAD=y
CONFIG_USB_FUNCTION_FASTBOOT=y
CONFIG_FASTBOOT_FLASH=y
CONFIG_FASTBOOT_FLASH_SPI=y
CONFIG_FASTBOOT_OEM_RUN=y
# CONFIG_FASTBOOT_FLASH_MMC is not set

# 关键补丁：解决 F1C200S USB 硬件 DMA Bug，必须开启 PIO 模式
# CONFIG_USB_MUSB_PIO_ONLY=y 

# USB 识别信息 (整合配置 1 的详细描述)
CONFIG_USB_GADGET_VENDOR_NUM=0x18d1
CONFIG_USB_GADGET_PRODUCT_NUM=0x4e40
CONFIG_USB_GADGET_MANUFACTURER="Allwinner"
CONFIG_USB_GADGET_VENDOR_NAME="Allwinner"
CONFIG_USB_GADGET_PRODUCT_NAME="F1C200S-Fastboot"

# --- 内存布局优化 (针对 64MB RAM) ---
# 将缓冲区移至 0x80800000，避免与 LOAD_ADDR (0x80500000) 冲突
CONFIG_FASTBOOT_BUF_ADDR=0x80800000
CONFIG_FASTBOOT_BUF_SIZE=0x02000000

# --- 自动化逻辑 ---
CONFIG_BOOTDELAY=0
CONFIG_MTDIDS_DEFAULT="nand0=spi-nand0"
CONFIG_BOOTCOMMAND="env set -f serial# RHODES_ISLAND_EPASS_FASTBOOT ; fastboot 0"
CONFIG_ENV_IS_NOWHERE=y
```
